// GENERATED by local workbench. Regenerate after source changes.
#define BRIDGE_SCHEMA_ID "4999732a5ba699d9069327acdbdfc7debb8c289d2fbcd74118e84e3d9d380497"
#include "motor.h"
#include "sensors.h"
extern motor_t drive_motor;
static esp_err_t bridge_get_0(double *out) { *out = drive_motor.duty_percent; return ESP_OK; }
static esp_err_t bridge_set_0(double value) { return motor_set_duty(&drive_motor, value); }
extern motor_t drive_motor;
static esp_err_t bridge_get_1(double *out) { *out = drive_motor.enabled; return ESP_OK; }
static esp_err_t bridge_set_1(double value) { return motor_set_enabled(&drive_motor, value); }
static esp_err_t bridge_get_2(double *out) { float value; esp_err_t err = sensor_read_temperature(&value); if (err == ESP_OK) *out = value; return err; }
static const bridge_field_t bridge_fields[] = {
    {"main/motor.c::drive_motor.duty_percent", true, false, 0, 100.0, bridge_get_0, bridge_set_0},
    {"main/motor.c::drive_motor.enabled", true, true, 0, 1, bridge_get_1, bridge_set_1},
    {"main/sensors.c::sensor_read_temperature", false, false, 0, 0, bridge_get_2, NULL}
};
